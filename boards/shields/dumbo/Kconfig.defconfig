## boards/shields/dumbo/Kconfig.defconfig
```kconfig
if SHIELD_DUMBO_LEFT

config ZMK_KEYBOARD_NAME
    default "Dumbo"

config ZMK_SPLIT_ROLE_CENTRAL
    default y

endif # SHIELD_DUMBO_LEFT

if SHIELD_DUMBO_LEFT || SHIELD_DUMBO_RIGHT

config ZMK_SPLIT
    default y

endif # SHIELD_DUMBO_LEFT || SHIELD_DUMBO_RIGHT
```

## boards/shields/dumbo/Kconfig.shield
```kconfig
config SHIELD_DUMBO_LEFT
    def_bool $(shields_list_contains,dumbo_left)

config SHIELD_DUMBO_RIGHT
    def_bool $(shields_list_contains,dumbo_right)
```
